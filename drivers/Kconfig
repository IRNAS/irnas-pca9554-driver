## drivers/Kconfig
```kconfig
# COPYRIGHT NOTICE: (c) 2022 Irnas. All rights reserved.
# Author: Marko Sagadin <marko@irnas.eu>

rsource "gpio/Kconfig.pca9554"
```

## drivers/gpio/Kconfig.pca9554
```kconfig
# COPYRIGHT NOTICE: (c) 2022 Irnas. All rights reserved.
# Author: Marko Sagadin <marko@irnas.eu>

menuconfig GPIO_PCA9554
	bool "PCA9554 I2C-based GPIO chip"
	default y
	depends on DT_HAS_IRNAS_PCA9554_ENABLED
	depends on I2C
	help
	  Enable driver for PCA9554 I2C-based GPIO chip.

if GPIO_PCA9554

config GPIO_PCA9554_INIT_PRIORITY
	int "Init priority"
	default 70
	help
	  Device driver initialization priority.
endif
```

## dts/bindings/irnas,pca9554.yaml
```yaml
# COPYRIGHT NOTICE: (c) 2022 Irnas. All rights reserved.
# Author: Marko Sagadin <marko@irnas.eu>

description: PCA9554 I2C-based GPIO expander

compatible: "irnas,pca9554"

include: [gpio-controller.yaml, i2c-device.yaml]

properties:
  "#gpio-cells":
    const: 2
    description: |
      Number of items to expect in a gpio-cells specifier. For example use see 
      the app.overlay in samples/basic.
      See https://docs.zephyrproject.org/3.1.0/build/dts/bindings.html#specifier-cell-names-cells
      or zephyr/dts/bindings/gpio-controller.yaml for more info.

gpio-cells:
  - pin
  - flags
```
